#include "forager.dtsi"

&default_transform {
    col-offset = <5>;
};

&kscan0 {
    col-gpios
    = <&gpio0 28 GPIO_ACTIVE_HIGH>   // COL0
    , <&gpio0 29 GPIO_ACTIVE_HIGH>   // COL1
    , <&gpio0 4 GPIO_ACTIVE_HIGH>    // COL2
    , <&gpio1 15 GPIO_ACTIVE_HIGH>   // COL3
    , <&gpio1 14 GPIO_ACTIVE_HIGH>   // COL4
    ;

    row-gpios
    = <&gpio1 13 (GPIO_ACTIVE_HIGH | GPIO_PULL_DOWN)>  // ROW1
    , <&gpio1 12 (GPIO_ACTIVE_HIGH | GPIO_PULL_DOWN)>  // ROW0
    , <&gpio0 3 (GPIO_ACTIVE_HIGH | GPIO_PULL_DOWN)>   // ROW2
    , <&gpio0 2 (GPIO_ACTIVE_HIGH | GPIO_PULL_DOWN)>   // ROW3
    ;
};